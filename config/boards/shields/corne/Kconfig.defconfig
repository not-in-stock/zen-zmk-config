## config/boards/shields/corne/Kconfig.defconfig
```kconfig
if SHIELD_CORNE_DONGLE || SHIELD_CORNE_CENTRAL_LEFT

config ZMK_KEYBOARD_NAME
    default "Corne"

config ZMK_SPLIT_ROLE_CENTRAL
    default y

endif

if SHIELD_CORNE_DONGLE || SHIELD_CORNE_CENTRAL_LEFT || SHIELD_CORNE_LEFT || SHIELD_CORNE_RIGHT

config ZMK_SPLIT
    default y

endif
```

## config/boards/shields/corne/Kconfig.shield
```kconfig
config SHIELD_CORNE_DONGLE
    def_bool $(shields_list_contains,corne_dongle)

config SHIELD_CORNE_CENTRAL_LEFT
    def_bool $(shields_list_contains,corne_central_left)

config SHIELD_CORNE_LEFT
    def_bool $(shields_list_contains,corne_left)

config SHIELD_CORNE_RIGHT
    def_bool $(shields_list_contains,corne_right)
```

## config/boards/shields/crpd/Kconfig.defconfig
```kconfig
if SHIELD_CRPD_DONGLE || SHIELD_CRPD_CENTRAL_LEFT

config ZMK_KEYBOARD_NAME
    default "Corne"

config ZMK_SPLIT_ROLE_CENTRAL
    default y

endif

if SHIELD_CRPD_DONGLE || SHIELD_CRPD_CENTRAL_LEFT || SHIELD_CRPD_LEFT || SHIELD_CRPD_RIGHT

config ZMK_SPLIT
    default y

endif
```

## config/boards/shields/crpd/Kconfig.shield
```kconfig
config SHIELD_CRPD_DONGLE
    def_bool $(shields_list_contains,crpd_dongle)

config SHIELD_CRPD_CENTRAL_LEFT
    def_bool $(shields_list_contains,crpd_central_left)

config SHIELD_CRPD_LEFT
    def_bool $(shields_list_contains,crpd_left)

config SHIELD_CRPD_RIGHT
    def_bool $(shields_list_contains,crpd_right)
```

## config/boards/shields/prospector/Kconfig.defconfig
```kconfig
if SHIELD_PROSPECTOR_DONGLE

config ZMK_KEYBOARD_NAME
    default "Prospector"

config ZMK_SPLIT_ROLE_CENTRAL
    default y

config ZMK_USB
    default y

endif

if SHIELD_PROSPECTOR_LEFT || SHIELD_PROSPECTOR_RIGHT || SHIELD_PROSPECTOR_DONGLE

config ZMK_SPLIT
    default y

config ZMK_BLE
    default y

endif
```

## config/boards/shields/prospector/Kconfig.shield
```kconfig
config SHIELD_PROSPECTOR_LEFT
    def_bool $(shields_list_contains,totem_left)

config SHIELD_PROSPECTOR_RIGHT
    def_bool $(shields_list_contains,totem_right)

config SHIELD_PROSPECTOR_DONGLE
    def_bool $(shields_list_contains,prospector_dongle)
```

## config/west.yml
```yaml
manifest:
  remotes:
    - name: zmkfirmware
      url-base: https://github.com/zmkfirmware
    - name: carrefinho
      url-base: https://github.com/carrefinho
    - name: caksoylar
      url-base: https://github.com/caksoylar
    - name: not-in-stock
      url-base: https://github.com/not-in-stock
    - name: urob
      url-base: https://github.com/urob
  projects:
    - name: zmk
      remote: not-in-stock
      revision: zen
      import: app/west.yml
    - name: zen-zmk-module
      remote: not-in-stock
      revision: main
    - name: prospector-zmk-module
      remote: not-in-stock
      revision: feat/add-display-sleep
    - name: zmk-helpers
      remote: urob
      revision: main
    - name: crpd-zmk-module
      remote: not-in-stock
      revision: main
  self:
    path: config
```
