#include <dt-bindings/zmk/mouse.h>

#define ZMK_MOUSE_DEFAULT_MOVE_VAL 1500  // 600
#define ZMK_MOUSE_DEFAULT_SCRL_VAL 20    // 10

&mmv {
    acceleration-exponent = <1>;      // 1
    time-to-max-speed-ms = <1500>;    // 40
    delay-ms = <0>;                   // 0
};

&msc {
    acceleration-exponent = <1>;      // 0
    time-to-max-speed-ms = <5000>;    // 40
    delay-ms = <0>;                   // 0
};

/* movement shortcuts */
#define MV_D MOVE_DOWN
#define MV_U MOVE_UP
#define MV_L MOVE_LEFT
#define MV_R MOVE_RIGHT

/* scorll shortcuts */
#define SC_U SCRL_UP
#define SC_D SCRL_DOWN
#define SC_L SCRL_LEFT
#define SC_R SCRL_RIGHT